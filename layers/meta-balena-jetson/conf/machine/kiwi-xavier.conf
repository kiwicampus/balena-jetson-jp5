## layers/meta-balena-jetson/conf/machine/kiwi-xavier.conf
```bitbake
#@TYPE: Machine
##@NAME: kiwi-xavier
##@DESCRIPTION: Machine configuration for the Kiwi Xavier Carrier Board for NVidia Jetson Xavier

MACHINEOVERRIDES = "jetson-xavier:${MACHINE}"
include conf/machine/jetson-xavier.conf

MACHINEOVERRIDES := "${@'${MACHINEOVERRIDES}'.replace(':${MACHINE}',':jetson-xavier:${MACHINE}')}"

# Override the device tree for custom hardware
KERNEL_DEVICETREE = "tegra194-agx-kiwi-AGX.dtb"
```
